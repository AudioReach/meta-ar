## conf/layer.conf
```bitbake
BBFILES += "${LAYERDIR}/recipes/*/*.bb ${LAYERDIR}/recipes/*/*.bbappend \
    ${LAYERDIR}/recipes-*/*/*.bb ${LAYERDIR}/recipes-*/*/*.bbappend"
BBPATH .= ":${LAYERDIR}"
BBFILE_COLLECTIONS += "meta-ar"
BBFILE_PRIORITY_meta-ar = "6"
BBFILE_PATTERN_meta-ar := "^${LAYERDIR}/"
LAYERSERIES_COMPAT_meta-ar = "whinlatter"
```
